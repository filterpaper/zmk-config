// Copyright @filterpaper
// SPDX-License-Identifier: MIT

#include <behaviors.dtsi>
#include <dt-bindings/zmk/bt.h>
#include <dt-bindings/zmk/keys.h>
#include <dt-bindings/zmk/outputs.h>

#define ZMK_POINTING_DEFAULT_MOVE_VAL 3000
#define ZMK_POINTING_DEFAULT_SCRL_VAL 80
#include <dt-bindings/zmk/pointing.h>

// Adjusted pin arrangement
&kscan0 {
    input-gpios
    = <&pro_micro  6 (GPIO_ACTIVE_LOW | GPIO_PULL_UP)>
    , <&pro_micro 18 (GPIO_ACTIVE_LOW | GPIO_PULL_UP)>
    , <&pro_micro 19 (GPIO_ACTIVE_LOW | GPIO_PULL_UP)>
    , <&pro_micro 20 (GPIO_ACTIVE_LOW | GPIO_PULL_UP)>
    , <&pro_micro 21 (GPIO_ACTIVE_LOW | GPIO_PULL_UP)>
    , <&pro_micro 15 (GPIO_ACTIVE_LOW | GPIO_PULL_UP)>
    , <&pro_micro 14 (GPIO_ACTIVE_LOW | GPIO_PULL_UP)>
    , <&pro_micro 16 (GPIO_ACTIVE_LOW | GPIO_PULL_UP)>
    , <&pro_micro 10 (GPIO_ACTIVE_LOW | GPIO_PULL_UP)>
    , <&pro_micro  1 (GPIO_ACTIVE_LOW | GPIO_PULL_UP)>
    , <&pro_micro  2 (GPIO_ACTIVE_LOW | GPIO_PULL_UP)>
    , <&pro_micro  3 (GPIO_ACTIVE_LOW | GPIO_PULL_UP)>
    , <&pro_micro  4 (GPIO_ACTIVE_LOW | GPIO_PULL_UP)>
    , <&pro_micro  5 (GPIO_ACTIVE_LOW | GPIO_PULL_UP)>
    , <&pro_micro  7 (GPIO_ACTIVE_LOW | GPIO_PULL_UP)>
    , <&pro_micro  8 (GPIO_ACTIVE_LOW | GPIO_PULL_UP)>
    , <&pro_micro  9 (GPIO_ACTIVE_LOW | GPIO_PULL_UP)>
    ;
};



#define CMK 1
#define SYM 2
#define NUM 3
#define FNC 4

#define TAPPING_TERM  225
#define QUICK_TAP_MS  105
#define SHIFT_TAP_MS  165
#define COMBO_IDLE_MS TAPPING_TERM
#define PRIOR_IDLE_MS QUICK_TAP_MS

&lt {
    flavor          = "hold-preferred";
    quick-tap-ms    = <QUICK_TAP_MS>;
    tapping-term-ms = <TAPPING_TERM>;
};

&mt {
    flavor          = "tap-preferred";
    quick-tap-ms    = <QUICK_TAP_MS>;
    tapping-term-ms = <TAPPING_TERM>;
};

&caps_word {
    continue-list = <UNDER MINUS BSPC LSHFT RSHFT LS(SPACE) RS(SPACE)>;
};

&mmv {
    acceleration-exponent = <1>;
    trigger-period-ms     = <8>;
    time-to-max-speed-ms  = <500>;
};

&msc {
    acceleration-exponent = <1>;
    trigger-period-ms     = <8>;
    time-to-max-speed-ms  = <250>;
};



#define HOLD_TAP(_name_,               \
                 _flavor_,             \
                 _tapping_term_,       \
                 _require_prior_idle_, \
                 _key_positions_)      \
_name_: hold_tap_##_name_ {                               \
    compatible                 = "zmk,behavior-hold-tap"; \
    #binding-cells             = <2>;                     \
    flavor                     = #_flavor_;               \
    quick-tap-ms               = <QUICK_TAP_MS>;          \
    tapping-term-ms            = <_tapping_term_>;        \
    require-prior-idle-ms      = <_require_prior_idle_>;  \
    hold-trigger-key-positions = <_key_positions_>;       \
    bindings                   = <&kp>, <&kp>;            \
};
#define L_SHIFT 13
#define R_SHIFT 16
#define L_KEYS 0 1 2 3 4 10 11 12 13 14 20 21 22 23 24 30 31 32 33
#define R_KEYS 5 6 7 8 9 15 16 17 18 19 25 26 27 28 29 30 31 32 33

/ {
    behaviors {
        // Clipboard shortcuts
        HOLD_TAP(ht, tap-preferred, TAPPING_TERM, PRIOR_IDLE_MS, 33)
        // Positional hold-tap for non-Shift modifiers
        HOLD_TAP(lmt, tap-preferred, TAPPING_TERM, PRIOR_IDLE_MS, L_SHIFT R_KEYS)
        HOLD_TAP(rmt, tap-preferred, TAPPING_TERM, PRIOR_IDLE_MS, R_SHIFT L_KEYS)
        // Positional hold-tap for Shift
        HOLD_TAP(lst, balanced, SHIFT_TAP_MS, 0, R_KEYS)
        HOLD_TAP(rst, balanced, SHIFT_TAP_MS, 0, L_KEYS)
    };
};



#define COMBO(_name_, _bindings_, _key_positions_) \
combo_##_name_ {                                   \
    timeout-ms            = <30>;                  \
    require-prior-idle-ms = <COMBO_IDLE_MS>;       \
    bindings              = <_bindings_>;          \
    key-positions         = <_key_positions_>;     \
    layers                = <0 1>;                 \
};
/* Key positions
 0  1  2  3  4   5  6  7  8  9
10 11 12 13 14  15 16 17 18 19
20 21 22 23 24  25 26 27 28 29
         30 31  32 33 */
/ {
    combos {
        compatible = "zmk,combos";
        // invoke macros
        COMBO(vim_q,  &vim_q,   0  1)
        COMBO(vim_s,  &vim_s,  20 21)
        COMBO(dir_up, &dir_up, 28 29)
        // media keys
        COMBO(vol_up, &kp C_VOL_UP,  9 19)
        COMBO(vol_dn, &kp C_VOL_DN, 19 29)
        // navigation
        COMBO(arr_up, &kp UARW, 17 27)
        COMBO(arr_dn, &kp DARW, 16 26)
        COMBO(arr_lt, &kp LARW, 15 25)
        COMBO(arr_rt, &kp RARW, 18 28)
        COMBO(pageup, &kp PG_UP, 7 17)
        COMBO(pagedn, &kp PG_DN, 6 16)
        // shortcuts
        COMBO(nav_up, &kp LS(LA(UARW)),  27 28)
        COMBO(nav_dn, &kp LS(LA(DARW)),  26 27)
        COMBO(sg_spc, &kp LS(LG(SPACE)), 12 13)
        // layer toggle
        COMBO(numb,   &tog NUM, 25 26 33)
        COMBO(func,   &tog FNC, 23 24 30)
    };
};



#define MACRO(_name_, _bindings_)          \
_name_: macro_##_name_ {                   \
    compatible     = "zmk,behavior-macro"; \
    #binding-cells = <0>;                  \
    tap-ms         = <1>;                  \
    wait-ms        = <1>;                  \
    bindings       = <_bindings_>;         \
};

/ {
    macros {
        MACRO(vim_q,  &kp COLON &kp Q &kp EXCL)
        MACRO(vim_s,  &kp COLON &kp X)
        MACRO(dir_up, &kp DOT &kp DOT &kp FSLH)
        MACRO(bt_0,   &out OUT_BLE &bt BT_DISC 1 &bt BT_SEL 0)
        MACRO(bt_1,   &out OUT_BLE &bt BT_DISC 0 &bt BT_SEL 1)
        MACRO(bt_2,   &out OUT_BLE &bt BT_DISC 0 &bt BT_SEL 2)
    };
};



#define MS_UP &mmv MOVE_UP
#define MS_DN &mmv MOVE_DOWN
#define MS_LT &mmv MOVE_LEFT
#define MS_RT &mmv MOVE_RIGHT
#define WH_UP &msc SCRL_UP
#define WH_DN &msc SCRL_DOWN
#define MS_B1 &mkp MB1
#define MS_B2 &mkp MB2

#define Z_SLEEP  &kp LA(LG(C_PWR))
#define Z_SSAVE  &kp LC(LA(LS(LG(S))))
#define NAV_UP   &kp LS(LA(UARW))
#define NAV_DN   &kp LS(LA(DARW))
#define ALT_BSP  &kp LA(BSPC)
#define ________ &trans

#define HRML(k1,k2,k3,k4) &lmt LCTRL k1  &lmt LALT k2  &lmt LGUI k3  &lst LSHFT k4
#define HRMR(k1,k2,k3,k4) &rst RSHFT k1  &rmt RGUI k2  &rmt RALT k3  &rmt RCTRL k4
#define HT(k1,k2,k3,k4)   &ht LG(V) k1   &ht LG(C) k2  &ht LG(X) k3  &ht LG(Z) k4

#define SYM_TAB  &lt SYM TAB
#define LCA_ENT  &mt LC(LALT) ENTER
#define SFT_SPC  &mt RSHFT SPACE
#define NUM_BSP  &lt NUM BSPC

/ {
    keymap {
        compatible = "zmk,keymap";
        BASE_layer {
            bindings = <
        //╭──────────┬──────────┬──────────┬──────────┬──────────╮   ╭──────────┬──────────┬──────────┬──────────┬──────────╮
        //│  Q       │  W       │  E       │  R       │  T       │   │  Y       │  U       │  I       │  O       │  P       │
            &kp Q      &kp W      &kp E      &kp R      &kp T          &kp Y      &kp U      &kp I      &kp O      &kp P
        //├──────────┼──────────┼──────────┼──────────┼──────────┤   ├──────────┼──────────┼──────────┼──────────┼──────────┤
        //│  A       │  S       │  D       │  F       │  G       │   │  H       │  J       │  K       │  L       │ ' "      │
           HRML(A,         S,         D,         F)     &kp G          &kp H     HRMR(J,         K,         L,        SQT)
        //├──────────┼──────────┼──────────┼──────────┼──────────┤   ├──────────┼──────────┼──────────┼──────────┼──────────┤
        //│  Z       │  X       │  C       │  V       │  B       │   │  N       │  M       │ , <      │ . >      │ / ?      │
            &kp Z      &kp X      &kp C      &kp V      &kp B          &kp N       HT(M,      COMMA,       DOT,      FSLH)
        //╰──────────┴──────────┴──────────┼──────────┼──────────┤   ├──────────┼──────────┼──────────┴──────────┴──────────╯
                                             SYM_TAB    LCA_ENT        SFT_SPC    NUM_BSP
        //                                 ╰──────────┴──────────╯   ╰──────────┴──────────╯
            >;
        };
        CMK_layer {
            bindings = <
        //╭──────────┬──────────┬──────────┬──────────┬──────────╮   ╭──────────┬──────────┬──────────┬──────────┬──────────╮
        //│  Q       │  W       │  F       │  P       │  G       │   │  J       │  L       │  U       │  Y       │ ' "      │
            &kp Q      &kp W      &kp F      &kp P      &kp G          &kp J      &kp L      &kp U      &kp Y      &kp SQT
        //├──────────┼──────────┼──────────┼──────────┼──────────┤   ├──────────┼──────────┼──────────┼──────────┼──────────┤
        //│  A       │  R       │  S       │  T       │  D       │   │  H       │  N       │  E       │  I       │  O       │
           HRML(A,         R,         S,         T)     &kp D          &kp H     HRMR(N,         E,         I,         O)
        //├──────────┼──────────┼──────────┼──────────┼──────────┤   ├──────────┼──────────┼──────────┼──────────┼──────────┤
        //│  Z       │  X       │  C       │  V       │  B       │   │  N       │  M       │ , <      │ . >      │ / ?      │
            &kp Z      &kp X      &kp C      &kp V      &kp B          &kp K       HT(M,      COMMA,       DOT,      FSLH)
        //╰──────────┴──────────┴──────────┼──────────┼──────────┤   ├──────────┼──────────┼──────────┴──────────┴──────────╯
                                             ________   ________       ________   ________
        //                                 ╰──────────┴──────────╯   ╰──────────┴──────────╯
            >;
        };
        SYM_layer {
            bindings = <
        //╭──────────┬──────────┬──────────┬──────────┬──────────╮   ╭──────────┬──────────┬──────────┬──────────┬──────────╮
        //│          │  [       │  {       │  }       │          │   │  ^       │  (       │  )       │  ]       │  ~       │
            ________   &kp LBKT   &kp LBRC   &kp RBRC   ________       &kp CARET  &kp LPAR   &kp RPAR   &kp RBKT   &kp TILDE
        //├──────────┼──────────┼──────────┼──────────┼──────────┤   ├──────────┼──────────┼──────────┼──────────┼──────────┤
        //│  !       │  @       │  #       │  $       │  %       │   │  *       │  -       │  =       │  \       │  `       │
            &kp EXCL   &kp AT     &kp HASH   &kp DLLR   &kp PRCNT      &kp ASTRK  &kp MINUS  &kp EQUAL  &kp BSLH   &kp GRAVE
        //├──────────┼──────────┼──────────┼──────────┼──────────┤   ├──────────┼──────────┼──────────┼──────────┼──────────┤
        //│          │          │  <       │  >       │          │   │  &       │  _       │  +       │  │       │          │
            ________   ________   &kp LT     &kp GT     ________       &kp AMPS   &kp UNDER  &kp PLUS   &kp PIPE   ________
        //╰──────────┴──────────┴──────────┼──────────┼──────────┤   ├──────────┼──────────┼──────────┴──────────┴──────────╯
                                             ________   ________       ________   ________
        //                                 ╰──────────┴──────────╯   ╰──────────┴──────────╯
            >;
        };
        NUM_layer {
            bindings = <
        //╭──────────┬──────────┬──────────┬──────────┬──────────╮   ╭──────────┬──────────┬──────────┬──────────┬──────────╮
        //│ INSERT   │  1       │  2       │  3       │ VOL UP   │   │ HOME     │ PAGE DN  │ PAGE UP  │ END      │  :       │
            &kp INS    &kp N1     &kp N2     &kp N3    &kp C_VOL_UP    &kp HOME   &kp PG_DN  &kp PG_UP  &kp END    &kp COLON
        //├──────────┼──────────┼──────────┼──────────┼──────────┤   ├──────────┼──────────┼──────────┼──────────┼──────────┤
        //│ CAPS     │  4       │  5       │  6       │ VOL DN   │   │ LEFT     │ DOWN     │ UP       │ RIGHT    │  ;       │
           &caps_word  &kp N4     &kp N5     &kp N6    &kp C_VOL_DN    &kp LEFT   &kp DOWN   &kp UP     &kp RIGHT  &kp SEMI
        //├──────────┼──────────┼──────────┼──────────┼──────────┤   ├──────────┼──────────┼──────────┼──────────┼──────────┤
        //│ DELETE   │  7       │  8       │  9       │  0       │   │          │ SHFTA DN │ SHFTA UP │          │          │
            &kp DEL    &kp N7     &kp N8     &kp N9     &kp N0         ________   NAV_DN     NAV_UP     ________   ________
        //╰──────────┴──────────┴──────────┼──────────┼──────────┤   ├──────────┼──────────┼──────────┴──────────┴──────────╯
                                             &mo FNC    &kp ESC        ________   ________
        //                                 ╰──────────┴──────────╯   ╰──────────┴──────────╯
            >;
        };
        FNC_layer {
            bindings = <
        //╭──────────┬──────────┬──────────┬──────────┬──────────╮   ╭──────────┬──────────┬──────────┬──────────┬──────────╮
        //│ RESET    │          │          │          │PROFILE 0 │   │          │ WHEEL UP │ WHEEL DN │          │ COLEMAK  │
           &sys_reset  ________   ________ &out OUT_BLE &bt_0          ________   WH_UP      WH_DN      ________   &tog CMK
        //├──────────┼──────────┼──────────┼──────────┼──────────┤   ├──────────┼──────────┼──────────┼──────────┼──────────┤
        //│BOOTLOADER│          │          │          │PROFILE 1 │   │ MOUSE LT │ MOUSE DN │ MOUSE UP │ MOUSE RT │BOOTLOADER│
          &bootloader  ________   ________ &out OUT_USB &bt_1          MS_LT      MS_DN      MS_UP      MS_RT     &bootloader
        //├──────────┼──────────┼──────────┼──────────┼──────────┤   ├──────────┼──────────┼──────────┼──────────┼──────────┤
        //│ SLEEP    │          │          │CLEAR PROF│PROFILE 2 │   │          │MOUSE BTN2│MOUSE BTN1│          │ SSAVE    │
            Z_SLEEP    ________   ________  &bt BT_CLR  &bt_2          ________   MS_B2      MS_B1      ________   Z_SSAVE
        //╰──────────┴──────────┴──────────┼──────────┼──────────┤   ├──────────┼──────────┼──────────┴──────────┴──────────╯
                                             ________   ________       ________   ________
        //                                 ╰──────────┴──────────╯   ╰──────────┴──────────╯
            >;
        };
    };
};
